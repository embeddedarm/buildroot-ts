## technologic/Config.in
```kconfig
source "$BR2_EXTERNAL_TECHNOLOGIC_PATH/package/ts7100-utils/Config.in"
source "$BR2_EXTERNAL_TECHNOLOGIC_PATH/package/ts7820-utils/Config.in"
comment "Other dependencies"
source "$BR2_EXTERNAL_TECHNOLOGIC_PATH/package/ecl/Config.in"
```

## technologic/package/ecl/Config.in
```kconfig
config BR2_PACKAGE_ECL
	bool "ECL (Embeddable Common-Lisp)"
	select BR2_PACKAGE_GMP
	select BR2_PACKAGE_BDWGC
	help
	  Embeddable Common-Lisp release 16.1.3
	  Intended for ts7820-utils package to support one of the libraries
	  required for operation.
	  
	  Note that without gcc on target, 'ecl' is likely not useful in any
	  other context.
```

## technologic/package/ts7180-utils/Config.in
```kconfig
config BR2_PACKAGE_TS7180_UTILS
	bool "ts7180-utils"
	help
	  Utilities tools for TS-7180 SBC
	  Includes tools to communicate with the supervisory microcontroller,
	  interface to FPGA, etc.
```

## technologic/package/ts7400v2-utils-linux4.x/Config.in
```kconfig
config BR2_PACKAGE_TS7670_UTILS_LINUX4.X
	bool "ts7400v2-utils-linux4.x"
	help
	  Utilities tools for TS-7400-V2 SBC for use with 4.x and newer kernels.

	  Includes tools to communicate with the supervisory microcontroller,
	  RTC NVRAM, and ADC helper.
```
